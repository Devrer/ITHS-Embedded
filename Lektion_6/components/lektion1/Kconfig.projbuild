## Lektion_6/components/lektion1/Kconfig.projbuild
```kconfig
menu "Lektion 1 Component"

	config EXEMPEL_TEXT
		string "Min text"
		default "Hej från lektion 1 "
		help
			Använd den här för att ställa vad som ska sägas
endmenu
```
